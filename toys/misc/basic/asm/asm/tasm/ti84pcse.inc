;===============================================================================
;====== Include Stuff ==========================================================
;===============================================================================

;Included for TASM Compatibility
;-------------------------------
#define equ .equ
#define EQU .equ
#define end .end
#define END .end

;Banked Call Equates/Macros
;-----------------------------------------------
#define bcall(xxxx) rst 28h \ .dw xxxx
#define b_call(xxxx) rst 28h \ .dw xxxx
#define	bcallz(xxxx)	jr nz,$+5 \ rst 28h \ .dw xxxx
#define	b_callz(xxxx)	jr nz,$+5 \ rst 28h \ .dw xxxx
#define	bcallnz(xxxx)	jr	z,$+5 \ rst 28h \ .dw xxxx
#define	b_callnz(xxxx)	jr	z,$+5 \ rst 28h \ .dw xxxx
#define	bcallc(xxxx)	jr nc,$+5 \ rst 28h \ .dw xxxx
#define	b_callc(xxxx)	jr nc,$+5 \ rst 28h \ .dw xxxx
#define	bcallnc(xxxx)	jr	c,$+5 \ rst 28h \ .dw xxxx
#define	b_callnc(xxxx)	jr	c,$+5 \ rst 28h \ .dw xxxx
#define bjump(xxxx) call 50h \ .dw xxxx

;Error Handler Equates/Macros
;-------------------------------------------
#define AppOnErr(xxxx) ld hl,xxxx \ call 59h
#define AppOffErr call 5Ch

; System routines
;-----------------------------------------------
_EnableCursorHook	equ	4F45h
_DisableCursorHook	equ	4F4Eh
_runIndicOn		equ	4564h
_runIndicOff		equ	4567h
_CheckOSValidated	equ	8117h

; Memory Equates
;-----------------------------------------------
appData			equ	8000h
ramCode			equ	8100h
tempSwapArea		equ	82B3h
statVars		equ	8C1Ch
localLanguage		equ	9E54h
cursorHookBlockPtr	equ	9E5Dh

; EXTENDED TOKENS
;-----------------------------------------------
; These are new on OSes after 1.15 or whatever
tExtTok			equ	0EFh

; MathPrint
tZQuadrant		equ	17h
tZFracHalf		equ	18h
tZFracThird		equ	19h
tZFracFourth		equ	1Ah
tZFracFifth		equ	1Bh
tZFracEighth		equ	1Ch
tZFracTenth		equ	1Dh
tFracSlash		equ	2Eh
tFracMixedNum		equ	2Fh
tSwapImProper		equ	30h
tSwapFracDec		equ	31h
tRemainder		equ	32h
tSummationSigma		equ	33h
tLogBase		equ	34h
tRandIntNoRep		equ	35h
tMathPrint		equ	37h
tClassic		equ	38h
tAutoAnswer		equ	3Bh
tDecAnswer		equ	3Ch
tFracAnswer		equ	3Dh

; TI-84+CSE
tBlue			equ	41h
tRed			equ	42h
tBlack 			equ	43h
tMagenta		equ	44h
tGreen			equ	45h
tOrange			equ	46h
tBrown			equ	47h
tNavy			equ	48h
tLtBlue			equ	49h
tYellow			equ	4Ah
tWhite			equ	4Bh
tLtGray			equ	4Ch
tMedGray		equ	4Dh
tGray			equ	4Eh
tDarkGray		equ	4Fh

tGraphColor		equ	65h
tTextColor		equ	67h
tBackgroundOn		equ	5Bh
tBackgroundOff		equ	64h

tThin			equ	74h
;tThick - 0x7E 0x06 (was "Connected"?)
tAsm84CPrgm		equ	68h
tAsm84CCmp		equ	69h
tBorderColor		equ	6Ch

; Flags
;------------------------------------
;flags			equ	8B26h

;appLwrCaseFlag		equ	24h ;duplicate
lwrCaseActive		equ	3

;------ Hardware Ports ---------------------------------------------------------
; p = Port
; LnkAst = Link Assist, Pg = Page
; Se = Silver Edition, Be = Basic Edition (anything NOT a TI-83+)
; Cfg = Configuration, Ctrl = Control, Buf = Buffer, Prot = Protection
; M = Memory, Int = Interrupt, Id = Identification, Crstl = Crystal
; Tmr = Timer, Div = Divided by, Rtc = Real Time Clock, Usb = USB
; Unk = Unknown, Exec = Execution
;
; R:n = RAM page n (always indexed from 0; no more saying RAM page 80h)
; F:nn = Flash page nn
; P:nn = Port nn
; LR:nn = LCD Register nn
pLink			equ	0
pKey			equ	1
pStatus			equ	2
pIntMask		equ	3
pIntId			equ	4
pMMapTmrFreq		equ	4
pMPgC			equ	5
pLnkAstBeRead		equ	5
pMPgA			equ	6
pMPgB			equ	7
pLnkAstSeEnable		equ	8
pLnkAstSeStatus		equ	9
pLnkAstSeInBuf		equ	0Ah
pLnkAstSeCfg		equ	0Ah
pLnkAstSeRcvTimeout	equ	0Bh
pLnkAstSeSndTimeout	equ	0Ch
pLnkAstSeOutBuf		equ	0Dh
pMPgAHigh		equ	0Eh
pMPgBHigh		equ	0Fh
pLcdCmd			equ	10h
pLcdData		equ	11h
pProtCtrl		equ	14h
pAsicId			equ	15h
pBeFlashExecCtrl	equ	16h
pCpuSpeed		equ	20h
pFlashTypeRamMask	equ	21h
pFlashType		equ	21h
pRamMask		equ	21h
pFlashExecLowerLimit	equ	22h
pFlashExecUpperLimit	equ	23h
pFlashExecExecOverride	equ	24h
pRamExecLowerLimit	equ	25h
pRamExecUpperLimit	equ	26h
pBlockMRemapC		equ	27h
pBlockMRemapB		equ	28h
pLcdDelay0		equ	29h
pLcdDelay1		equ	2Ah
pLcdDelay2		equ	2Bh
pLcdDelay3		equ	2Ch
pUnknown2D		equ	2Dh
pMemDelay		equ	2Eh
pLcdGenDelay		equ	2Fh
pCrstlTmr1Freq		equ	30h
pCrstlTmr1Cfg		equ	31h
pCrstlTmr1Count		equ	32h
pCrstlTmr2Freq		equ	33h
pCrstlTmr2Cfg		equ	34h
pCrstlTmr2Count		equ	35h
pCrstlTmr3Freq		equ	36h
pCrstlTmr3Cfg		equ	37h
pCrstlTmr3Count		equ	38h
pUsbUnkOldFlg		equ	39h
pUsbUnkOldFlg2		equ	3Ah
pRtcCtrl		equ	40h
pRtcSet0		equ	41h
pRtcSet1		equ	42h
pRtcSet2		equ	43h
pRtcSet3		equ	44h
pRtc0			equ	45h ; Reading
pRtc1			equ	46h
pRtc2			equ	47h
pRtc3			equ	48h

; Constants for bitfields
; St = Status, Batt = Batteries
; Rcv = Receive, Snd = Send, Err = Error
; Port 2 (pStatus)
stBattGood		equ	1
stLcdReady		equ	2
stFlashUnlocked		equ	4
stIsNot83pSe		equ	5
stIsSeModel		equ	7
; Port 3 (pIntMask)
intMaskOnKey		equ	1
intMaskTmr1		equ	2
intMaskTmr2		equ	4
intDisableLowPowerMode	equ	8
intMaskLinkport		equ	10h
intMaskNormal		equ	intMaskOnKey+intMaskTmr1+intDisableLowPowerMode
; Port 4 (pMMapTmrFreq)
intIdOnKey		equ	1
intIdTmr1		equ	2
intIdTmr2		equ	4
intIdOnKeyDown		equ	8
intIdLinkport		equ	16
intIdCrstlTmr1		equ	32
intIdCrstlTmr2		equ	64
intIdCrstlTmr3		equ	128
memMapMode0		equ	0
memMapMode1		equ	1
tmrFreq0		equ	0
tmrFreq1		equ	2
tmrFreq2		equ	4
tmrFreq3		equ	6
battVoltage0		equ	0
battVoltage1		equ	64
battVoltage2		equ	128
battVoltage3		equ	192
; Port 8 (pLnkAstSeEnable)
lnkSeIntRcv		equ	1
lnkSeIntSnd		equ	2
lnkSeIntErr		equ	4
lnkSeIntDisable		equ	128
lnkSeRcving		equ	8
lnkSeRcvd		equ	16
lnkSeSndReady		equ	32
lnkSndErr		equ	64
lnkSnding		equ	128
; Port 14h (pProtCtrl)
protLockFlash		equ	0
protUnlockFlash		equ	1
; Port 15h (pAsicId)
asic83pTA2		equ	33h
asic84pTA2		equ	44h
asic84pTA3		equ	45h
asic84pTA1		equ	55h
; Port 20h (pCpuSpeed)
cpu6MHz			equ	0
cpu15MHz		equ	1
cpu15MHz2		equ	2
cpu15MHz3		equ	3
; Port 21h (pFlashTypeRamMask)
flashTypeMask		equ	3
flashType1MB		equ	0
flashType2MB		equ	1
flashType4MB		equ	4
flashTyle8MB		equ	8
ramExecModeMask		equ	30h
ramExecMode0		equ	00h
ramExecMode1		equ	10h
ramExecMode2		equ	20h
ramExecMode3		equ	30h
; Port 24h (pFlashExecExecOverride)
flashAllowExecAll	equ	1
flashForbidExecAll	equ	2	; Except boot pages and overrides in bit 0 and port 22
; Ports 29h-2Ch (pLcdDelay0-3)
delayFlashEnable	equ	1
delayRamEnable		equ	2
delayCycleCountMask	equ	0FCh
delayCycleCountShift	equ	2
; Port 2E (pMemDelay)
delayFlashExec		equ	1
delayFlashRead		equ	2
delayFlashWrite		equ	4
delayRamExec		equ	10h
delayRamRead		equ	20h
delayRamWrite		equ	40h
; Port 2F (pLcdGenDelay)
cpu1LcdDelay48		equ	0
cpu1LcdDelay112		equ	1
cpu1LcdDelay176		equ	2
cpu1LcdDelay240		equ	3
cpu2LcdDelay48		equ	0
cpu2LcdDelay112		equ	4
cpu2LcdDelay176		equ	8
cpu2LcdDelay240		equ	12
cpu2LcdDelay304		equ	16
cpu2LcdDelay368		equ	20
cpu2LcdDelay432		equ	24
cpu2LcdDelay496		equ	28
cpu3LcdDelay48		equ	0
cpu3LcdDelay112		equ	32
cpu3LcdDelay176		equ	64
cpu3LcdDelay240		equ	96
cpu3LcdDelay304		equ	128
cpu3LcdDelay368		equ	160
cpu3LcdDelay432		equ	192
cpu3LcdDelay496		equ	224
; Crystal Timer Equates
tmrOff			equ	0
tmr11000Hz		equ	40h
tmr1000Hz		equ	41h
tmr100Hz		equ	42h
tmr10Hz			equ	43h
tmr32768Hz		equ	44h
tmr2048Hz		equ	45h
tmr128Hz		equ	46h
tmr8Hz			equ	47h
tmrCpu			equ	80h
tmrCpuDiv2		equ	81h
tmrCpuDiv4		equ	82h
tmrCpuDiv8		equ	84h
tmrCpuDiv16		equ	88h
tmrCpuDiv32		equ	90h
tmrCpuDiv64		equ	0A0h
tmrNullAck		equ	0
tmrLoop			equ	1
tmrInt			equ	2
tmrLoopAndInt		equ	3
; Port 40h (pRtcCtrl)
rtcEnable		equ	1
rtcSetCommand		equ	2

;------ Other (put me somewhere else better if needed) -------------------------
appLwrCaseFlag		equ	36


;------ Color LCD Control Registers --------------------------------------------
; Color LCD-Related Stuff
; lr = LCD Register, Disp = Display, Win = Window, Img = Image
; Col = Column, Cur = Cursor, Vert = vertical, Horiz = Horizontal
; Use these macros with the bitfield definitions below.
#define lcdHigh(x) x >> 8
#define lcdLow(x) x & 255

; Registers
lrSync			equ	0
lrDriverCode		equ	0
lrOutCtrl1		equ	1
lrDriveCtrl		equ	2
lrEntryMode		equ	3
lrRow			equ	20h
lrCol			equ	21h
lrGram			equ	22h
lrWinRowStart		equ	50h
lrWinRowEnd		equ	51h
lrWinColStart		equ	52h
lrWinColEnd		equ	53h
lrBaseImgDispCtrl	equ	61h
lrHorizScroll		equ	6Ah

; Register 1 (lrOutCtrl1) Bitfields
lcdReverseCol		equ	0100h
lcdReverseRow		equ	0400h
; Register 2 (lrDriveCtrl) Bitfields
lcdEOR			equ	0100h
lcdBDivC		equ	0200h
; Register 3 (lrDispCtrl1) Bitfields
lcdAM			equ	0008h	; If set, the cursor moves left/right after every write.
lcdCurMoveHoriz		equ	lcdAM	; Alias
lcdVertInc		equ	0010h	; If unset, the cursor is instead decremented
lcdHorizInc		equ	0020h	
lcdORG			equ	0080h	; If set, when window is changed, cursor is reset to corner
lcdBGR			equ	1000h
lcdTRI			equ	4000h	; If set, 18-bit color is accepted
lcdDFM			equ	8000h	; Unpacked mode: Write R, G, and B separately if TRI is set
; Register 61 (lrBaseImgDispCtrl) Bitfields
lcdREV			equ	0001h	; If set, reverse color mode
lcdVLE			equ	0002h	; If set, lrHorizScroll is enabled

kbdFlags	.equ	00h
trigFlags	.equ	00h
trigDeg	.equ	2
kbdSCR	.equ	3
kbdKeyPress	.equ	4

plotFlags	.equ	02h
plotTrace	.equ	0
plotDisp	.equ	2

graphFlags	.equ	03h
graphProg	.equ	1

textFlags	.equ	05h
textEraseBelow	.equ	1
textScrolled	.equ	2
textInverse	.equ	3
textInsMode	.equ	4

ParsFlag2	.equ	07h
numOP1	.equ	0

apdFlags	.equ	08h
maybe_preClrForMode	.equ	0
apdAble	.equ	2
apdRunning	.equ	3

onFlags	.equ	09h
appWantAlphaUpDn	.equ	0
onInterrupt	.equ	4
statsValid	.equ	6

curFlags	.equ	0Ch
fmtEditFlags	.equ	0Ch
fmtEdit	.equ	0
curAble	.equ	2
curOn	.equ	3
curLock	.equ	4

appFlags	.equ	0Dh
appTextSave	.equ	1
appAutoScroll	.equ	2
appCurGraphic	.equ	5
appCurWord	.equ	6

seqFlags	.equ	0Fh
webMode	.equ	0

plotFlag2	.equ	11h
expr_param	.equ	3
expr_writing	.equ	4

shiftFlags	.equ	12h
indicOnly	.equ	2
shift2nd	.equ	3
shiftAlpha	.equ	4
shiftLwrAlph	.equ	5
shiftALock	.equ	6

sGrFlags	.equ	14h
grfSplit	.equ	0
vertSplit	.equ	1
grfSplitOverride	.equ	3
write_on_graph	.equ	4

smartFlags	.equ	17h
smartGraph	.equ	0
smartGraph_inv	.equ	1

gkKeyRepeating	.equ	0

remoteKeyPress	.equ	5

maybe_fullScrnTextDraw	.equ	4

appRetOffKey	.equ	7

appWantDiagonalKeys	.equ	0

asm_Flag1       .equ  21h
asm_Flag2       .equ  22h
asm_Flag3       .equ  23h

fontFlags	.equ	32h
fracDrawLFont	.equ	2
drawLFont	.equ	6

ignoreBPLink	.equ	3

getKeyHookActive	.equ	0
rawKeyHookActive	.equ	5
cursorHookActive	.equ	7

localizeHookActive	.equ	1
windowHookActive	.equ	2
fontHookActive	.equ	5
regraphHookActive	.equ	6
drawingHookActive	.equ	7

usbHookActive	.equ	0

DBKeyFlags	.equ	3Dh
haveDBKey	.equ	5
HWLinkErrF	.equ	7

textDrawColor	.equ	4



rOP1TOOP2	.equ	00008h
LCD_BUSY_LOL	.equ	0000Bh
rFINDSYM	.equ	00010h
rPUSHREALO1	.equ	00018h
rMOV9TOOP1	.equ	00020h
rBR_CALL	.equ	00028h
rFPADD	.equ	00030h
BRT_JUMP0	.equ	00050h
APP_PUSH_ERRORH	.equ	00059h
APP_POP_ERRORH	.equ	0005Ch

appSearchPage	.equ	08283h
kbdScanCode	.equ	0844Dh
kbdLGSC	.equ	0844Eh
kbdPSC	.equ	0844Fh
kbdWUR	.equ	08450h
kbdDebncCnt	.equ	08451h
kbdKey	.equ	08452h
kbdGetKy	.equ	08453h
keyExtend	.equ	08454h
apdSubTimer	.equ	08456h
apdTimer	.equ	08457h
curTime	.equ	08458h
curRow	.equ	08459h
curCol	.equ	0845Ah
lFont_record	.equ	08463h
sFont_record	.equ	08487h
OP1	.equ	084AEh
OP2	.equ	084B9h
OP3	.equ	084C4h
OP4	.equ	084CFh
OP5	.equ	084DAh
OP6	.equ	084E5h
nameBuff	.equ	08519h
iMathPtr1	.equ	08525h
iMathPtr2	.equ	08527h
iMathPtr3	.equ	08529h
iMathPtr4	.equ	0852Bh
iMathPtr5	.equ	0852Dh
iMathPtr6	.equ	0852Fh
iMathPtr7	.equ	08531h
iMathPtr8	.equ	08533h
chkDelPtr1	.equ	08535h
chkDelPtr2	.equ	08537h
insDelPtr	.equ	08539h
maybe_fOutDat	.equ	0853Dh
asm_data_ptr1	.equ	08543h
asm_data_ptr2	.equ	08545h
textShadow	.equ	08560h
textShadCur	.equ	08664h
textShadTop	.equ	08666h
textShadAlph	.equ	08667h
textShadIns	.equ	08668h
cxCurApp	.equ	08676h
onSP	.equ	08686h
MenuCurrent	.equ	086A9h
maybe_ioPrompt	.equ	08700h
ioFlag	.equ	0871Bh
header	.equ	0871Fh
ioData	.equ	08728h
ioNewData	.equ	08734h
penCol	.equ	08782h
penRow	.equ	08784h
rclQueue	.equ	08785h
errNo	.equ	08789h
errSP	.equ	0878Ah
usermem_offset	.equ	08B22h
flags	.equ	08B26h
maybe_curGX2	.equ	08E6Eh
maybe_lcdTallP	.equ	08F02h
maybe_pixWide_m_1	.equ	08F05h
orgXmin	.equ	09250h
panShift	.equ	09259h
uXmin	.equ	09264h
uXmax	.equ	0926Dh
uXscl	.equ	09276h
uYmin	.equ	0927Fh
uYmax	.equ	09288h
uYscl	.equ	09291h
uThetMin	.equ	0929Ah
uThetMax	.equ	092A3h
uThetStep	.equ	092ACh
uTmin	.equ	092B5h
uTmax	.equ	092BEh
uTStep	.equ	092C7h
uPlotStart	.equ	092D0h
unMax	.equ	092D9h
uu0	.equ	092E2h
uv0	.equ	092EBh
unMin	.equ	092F4h
uu02	.equ	092FDh
uv02	.equ	09306h
uw02	.equ	0932Ah
Xmin	.equ	09336h
Xmax	.equ	0933Fh
Xscl	.equ	09348h
Ymin	.equ	09351h
Ymax	.equ	0935Ah
Yscl	.equ	09363h
ThetaMin	.equ	0936Ch
ThetaMax	.equ	09375h
ThetaStep	.equ	0937Eh
TminPar	.equ	09387h
TmaxPar	.equ	09390h
Tstep	.equ	09399h
PlotStart	.equ	093A2h
nMax	.equ	093ABh
u0	.equ	093B4h
v0	.equ	093BDh
nMin	.equ	093C6h
u02	.equ	093CFh
v02	.equ	093D8h
w02	.equ	093FCh
un1	.equ	09405h
vn1	.equ	09417h
wn1	.equ	09429h
XFact	.equ	09525h
YFact	.equ	0952Eh
deltaX	.equ	09538h
deltaY	.equ	09541h
shortX	.equ	0954Ah
shortY	.equ	09553h
maybe_XOutSym	.equ	09574h
XOutDat	.equ	09576h
maybe_YOutSym	.equ	09578h
YOutDat	.equ	0957Ah
inputSym	.equ	0957Ch
maybe_inputDat	.equ	0957Eh
TblMin	.equ	097EBh
TblStep	.equ	097F4h
ES	.equ	0983Eh
parseVar	.equ	09B8Eh
begPC	.equ	09B97h
curPC	.equ	09B99h
endPC	.equ	09B9Bh
cmdShadow	.equ	09BAAh
editTop	.equ	09CB4h
editCursor	.equ	09CB6h
editTail	.equ	09CB8h
editBtm	.equ	09CBAh
maybe_editSym	.equ	09CC6h
maybe_editDat	.equ	09CC8h
modePtr	.equ	09D84h
winTop	.equ	09D86h
winBtm	.equ	09D87h
winLeftEdge	.equ	09D88h
winLeft	.equ	09D89h
winAbove	.equ	09D8Bh
fmtDigits	.equ	09D91h
fmtString	.equ	09D92h
maybe_fmtMatSym	.equ	09DE9h
maybe_fmtMatMem	.equ	09DEBh
EQS	.equ	09DEDh
maybe_tSymPtr1	.equ	09DF9h
maybe_tSymPtr2	.equ	09DFBh
maybe_chkDelPtr3	.equ	09DFDh
maybe_chkDelPtr4	.equ	09DFFh
FPS	.equ	09E05h
OPBase	.equ	09E07h
OPS	.equ	09E09h
pTempCnt	.equ	09E0Bh
pTemp	.equ	09E0Fh
progPtr	.equ	09E11h
maybe_newDataPtr	.equ	09E13h
pagedCount	.equ	09E15h
pagedPN	.equ	09E16h
pagedGetPtr	.equ	09E17h
pagedPutPtr	.equ	09E19h
pagedBuf	.equ	09E1Bh
cursorHookPtr	.equ	09E5Dh
rawKeyHookPtr	.equ	09E65h
getKeyHookPtr	.equ	09E69h
windowHookPtr	.equ	09E71h
fontHookPtr	.equ	09E7Dh
regraphHookPtr	.equ	09E81h
drawingHookPtr	.equ	09E85h
localizeHookPtr	.equ	09EADh
usbHookPtr	.equ	09EB5h
DBKeyScanCode	.equ	09FABh
DBKeyRptCtr	.equ	09FACh
textFGColor	.equ	0A015h
textBGColor	.equ	0A017h
drawBGColor	.equ	0A036h
drawFGColor	.equ	0A038h
userMem	.equ	0A60Bh
symTable	.equ	0FD9Eh



_JErrorNo	.equ	4000h
_CallFontHook	.equ	4003h
_CallLocalizeHook	.equ	4006h
_LdHLind	.equ	4009h
_CpHLDE	.equ	400Ch
_DivHLBy10	.equ	400Fh
_DivHLByA	.equ	4012h
_KbdScan	.equ	4015h
_GetCSC	.equ	4018h
_coorMon	.equ	401Bh
_Mon	.equ	401Eh
_monForceKey	.equ	4021h
_SendKPress	.equ	4024h
_JForceCmdNoChar	.equ	4027h
_JForceCmd	.equ	402Ah
_sysErrHandler	.equ	402Dh
_NewContext	.equ	4030h
_maybe_NewContext0	.equ	4033h
_maybe_PPutAwayPrompt	.equ	4036h
_maybe_PPutAway	.equ	4039h
_maybe_PutAway	.equ	403Ch
_maybe_SizeWind	.equ	403Fh
_maybe_ErrorEP	.equ	4042h
_maybe_CallMain	.equ	4045h
_monErrHand	.equ	4048h
_maybe_AppInit	.equ	404Bh
_initialize	.equ	404Eh
_Min	.equ	4051h
_Max	.equ	4054h
_AbsO1PAbsO2	.equ	4057h
_Intgr	.equ	405Ah
_Trunc	.equ	405Dh
_InvSub	.equ	4060h
_Times2	.equ	4063h
_Plus1	.equ	4066h
_Minus1	.equ	4069h
_FPSub	.equ	406Ch
_FPAdd	.equ	406Fh
_maybe_DToR	.equ	4072h
_maybe_RToD	.equ	4075h
_Cube	.equ	4078h
_TimesPt5	.equ	407Bh
_FPSquare	.equ	407Eh
_FPMult	.equ	4081h
_LJRnd	.equ	4084h
_InvOP1SC	.equ	4087h
_InvOP1S	.equ	408Ah
_InvOP2S	.equ	408Dh
_Frac	.equ	4090h
_FPRecip	.equ	4093h
_FPDiv	.equ	4096h
_SqRoot	.equ	4099h
_RndGuard	.equ	409Ch
_RnFx	.equ	409Fh
_Int	.equ	40A2h
_Round	.equ	40A5h
_LnX	.equ	40A8h
_LogX	.equ	40ABh
_LJNoRnd	.equ	40AEh
_EToX	.equ	40B1h
_TenX	.equ	40B4h
_SinCosRad	.equ	40B7h
_Sin	.equ	40BAh
_Cos	.equ	40BDh
_Tan	.equ	40C0h
_SinHCosH	.equ	40C3h
_TanH	.equ	40C6h
_CosH	.equ	40C9h
_SinH	.equ	40CCh
_ACosRad	.equ	40CFh
_ATanRad	.equ	40D2h
_ATan2Rad	.equ	40D5h
_ASinRad	.equ	40D8h
_ACos	.equ	40DBh
_ATan	.equ	40DEh
_ASin	.equ	40E1h
_ATan2	.equ	40E4h
_ATanH	.equ	40E7h
_ASinH	.equ	40EAh
_ACosH	.equ	40EDh
_PToR	.equ	40F0h
_RToP	.equ	40F3h
_HLTimes9	.equ	40F6h
_CkOP1Cplx	.equ	40F9h
_CkOP1Real	.equ	40FCh
_Angle	.equ	40FFh
_COP1Set0	.equ	4102h
_CpOP4OP3	.equ	4105h
_Mov9OP2Cp	.equ	4108h
_AbsO1O2Cp	.equ	410Bh
_CpOP1OP2	.equ	410Eh
_OP3ToOP4	.equ	4111h
_OP1ToOP4	.equ	4114h
_OP2ToOP4	.equ	4117h
_OP4ToOP2	.equ	411Ah
_OP3ToOP2	.equ	411Dh
_OP1ToOP3	.equ	4120h
_OP5ToOP2	.equ	4123h
_OP5ToOP6	.equ	4126h
_OP5ToOP4	.equ	4129h
_OP1ToOP2	.equ	412Ch
_OP6ToOP2	.equ	412Fh
_OP6ToOP1	.equ	4132h
_OP4ToOP1	.equ	4135h
_OP5ToOP1	.equ	4138h
_OP3ToOP1	.equ	413Bh
_OP6ToOP5	.equ	413Eh
_OP4ToOP5	.equ	4141h
_OP3ToOP5	.equ	4144h
_OP2ToOP5	.equ	4147h
_OP2ToOP6	.equ	414Ah
_OP1ToOP6	.equ	414Dh
_OP1ToOP5	.equ	4150h
_OP2ToOP1	.equ	4153h
_Mov11B	.equ	4156h
_Mov10B	.equ	4159h
_Mov9B	.equ	415Ch
_Mov8B	.equ	4162h
_Mov7B	.equ	4165h
_OP2ToOP3	.equ	416Bh
_OP4ToOP3	.equ	416Eh
_OP5ToOP3	.equ	4171h
_OP4ToOP6	.equ	4174h
_Mov9ToOP1	.equ	4177h
_Mov9OP1OP2	.equ	417Ah
_Mov9ToOP2	.equ	417Dh
_MovFrOP1	.equ	4180h
_OP4Set1	.equ	4183h
_OP3Set1	.equ	4186h
_OP2Set8	.equ	4189h
_OP2Set5	.equ	418Ch
_OP2SetA	.equ	418Fh
_OP2Set4	.equ	4192h
_OP2Set3	.equ	4195h
_OP1Set1	.equ	4198h
_OP1Set4	.equ	419Bh
_OP1Set3	.equ	419Eh
_OP3Set2	.equ	41A1h
_OP1Set2	.equ	41A4h
_OP2Set2	.equ	41A7h
_OP2Set1	.equ	41AAh
_Zero16D	.equ	41ADh
_OP5Set0	.equ	41B0h
_OP4Set0	.equ	41B3h
_OP3Set0	.equ	41B6h
_OP2Set0	.equ	41B9h
_OP1Set0	.equ	41BCh
_SetNum0	.equ	41BFh
_ZeroOP1	.equ	41C2h
_ZeroOP2	.equ	41C5h
_ZeroOP3	.equ	41C8h
_ZeroOP	.equ	41CBh
_ClrLp	.equ	41CEh
_ShRAcc	.equ	41D1h
_ShLAcc	.equ	41D4h
_ShR18	.equ	41D7h
_ShR18A	.equ	41DAh
_ShR16	.equ	41DDh
_ShR14	.equ	41E0h
_ShL16	.equ	41E3h
_ShL14	.equ	41E6h
_SRDO1	.equ	41E9h
_ShRDRnd	.equ	41ECh
_MantPA	.equ	41EFh
_ADDPROP	.equ	41F2h
_ADDPROPLP	.equ	41F5h
_Add16D	.equ	41F8h
_Add14D	.equ	41FBh
_Sub16D	.equ	41FEh
_Sub14D	.equ	4201h
_OP2ExOP6	.equ	4204h
_OP5ExOP6	.equ	4207h
_OP1ExOP5	.equ	420Ah
_OP1ExOP6	.equ	420Dh
_OP2ExOP4	.equ	4210h
_OP2ExOP5	.equ	4213h
_OP1ExOP3	.equ	4216h
_OP1ExOP4	.equ	4219h
_OP1ExOP2	.equ	421Ch
_ExLp	.equ	421Fh
_CkOP1C0	.equ	4222h
_CkOP1FP0	.equ	4225h
_CkOP2FP0	.equ	4228h
_PosNo0Int	.equ	422Bh
_CkPosInt	.equ	422Eh
_CkInt	.equ	4231h
_CkOdd	.equ	4234h
_CkOP1M	.equ	4237h
_GetCon1	.equ	423Ah
_GetCon	.equ	423Dh
_PIDIV2	.equ	4240h
_PIDIV4	.equ	4243h
_TWOPI	.equ	4246h
_PICON	.equ	4249h
_ExpToHex	.equ	424Ch
_OP1ExpToDec	.equ	424Fh
_CkOP2Pos	.equ	4252h
_CkOP1Pos	.equ	4255h
_ClrOP2S	.equ	4258h
_ClrOP1S	.equ	425Bh
_FDiv100	.equ	425Eh
_FDiv10	.equ	4261h
_DecO1Exp	.equ	4264h
_IncO1Exp	.equ	4267h
_IncExp	.equ	426Ah
_CkValidNum	.equ	426Dh
_GetExp	.equ	4270h
_HTimesL	.equ	4273h
_EOP1NotReal	.equ	4276h
_ThetaName	.equ	4279h
_RName	.equ	427Ch
_RegEqName	.equ	427Fh
_RecurNName	.equ	4282h
_XName	.equ	4285h
_YName	.equ	4288h
_TName	.equ	428Bh
_RealName	.equ	428Eh
_SetEStoFPS	.equ	4291h
_ChkTempDirt	.equ	4294h
_OP1MOP2Exp	.equ	4297h
_OP1ExpMDE	.equ	429Ah
_ChkErrBreak	.equ	429Dh
_IsA2ByteTok	.equ	42A0h
_maybe_GetLastEntry	.equ	42A3h
_maybe_GetLastEntryPtr	.equ	42A6h
_maybe_RegrClrChng	.equ	42A9h
_ResetWinTop	.equ	42ACh
_IsO1NonTLstOrProg	.equ	42AFh
_IsO1NonTempLst	.equ	42B2h
_Is_A_LstOrCLst	.equ	42B5h
_Chk_HL_999	.equ	42B8h
_Equ_or_NewEqu	.equ	42BBh
_ErrD_OP1NotPos	.equ	42BEh
_ErrD_OP1Not_R	.equ	42C1h
_ErrD_OP1NotPosInt	.equ	42C4h
_ErrD_OP1_LE_0	.equ	42C7h
_ErrD_OP1_0	.equ	42CAh
_FindSym_Get_Size	.equ	42CDh
_Sto_StatVar	.equ	42D0h
_maybe_Rcl_StatVar	.equ	42D3h
_CkOP2Real	.equ	42D6h
_maybe_Get_X_Indirect	.equ	42D9h
_MemChk	.equ	42DCh
_CmpPrgNamLen1	.equ	42DFh
_CmpPrgNamLen	.equ	42E2h
_FindProgSym	.equ	42E5h
_ChkFindSym	.equ	42E8h
_FindSym	.equ	42EBh
_InsertMem	.equ	42EEh
_InsertMemA	.equ	42F1h
_EnoughMem	.equ	42F4h
_CmpMemNeed	.equ	42F7h
_maybe_CreatePVar4	.equ	42FAh
_maybe_CreatePVar3	.equ	42FDh
_maybe_CreateVar3	.equ	4300h
_CreateCplx	.equ	4303h
_CreateReal	.equ	4306h
_CreateTRList	.equ	4309h
_CreateRList	.equ	430Ch
_CreateTCList	.equ	430Fh
_CreateCList	.equ	4312h
_CreateTRMat	.equ	4315h
_CreateRMat	.equ	4318h
_CreateTStrng	.equ	431Bh
_CreateStrng	.equ	431Eh
_Create0Equ	.equ	4321h
_CreateTEqu	.equ	4324h
_CreateEqu	.equ	4327h
_CreateGDB	.equ	432Dh
_CreateProg	.equ	4330h
_ChkDel	.equ	4333h
_ChkDelA	.equ	4336h
_AdjParser	.equ	4339h
_AdjMath	.equ	433Ch
_AdjM7	.equ	433Fh
_DelMemA	.equ	4342h
_Get_Form_Num	.equ	4345h
_DelVar	.equ	4348h
_DelVarIO	.equ	434Bh
_DelMem	.equ	434Eh
_DelVar3D	.equ	4351h
_DelVar3C	.equ	4354h
_DelVar3DC	.equ	4357h
_Sym_Prog_Non_T_Lst	.equ	435Ah
_AdjSymPtrs	.equ	435Dh
_DataSizeA	.equ	4360h
_DataSize	.equ	4363h
_PopMCplxO1	.equ	4366h
_PopMCplx	.equ	4369h
_MovCplx	.equ	436Ch
_PopOP5	.equ	436Fh
_PopOP3	.equ	4372h
_PopOP1	.equ	4375h
_PopRealO6	.equ	4378h
_PopRealO5	.equ	437Bh
_PopRealO4	.equ	437Eh
_PopRealO3	.equ	4381h
_PopRealO2	.equ	4384h
_PopRealO1	.equ	4387h
_PopReal	.equ	438Ah
_FPopCplx	.equ	438Dh
_FPopReal	.equ	4390h
_FPopFPS	.equ	4393h
_DeallocFPS	.equ	4396h
_DeallocFPS1	.equ	4399h
_AllocFPS	.equ	439Ch
_AllocFPS1	.equ	439Fh
_PushRealO6	.equ	43A2h
_PushRealO5	.equ	43A5h
_PushRealO4	.equ	43A8h
_PushRealO3	.equ	43ABh
_PushRealO2	.equ	43AEh
_PushRealO1	.equ	43B1h
_PushReal	.equ	43B4h
_PushOP5	.equ	43B7h
_PushOP3	.equ	43BAh
_PushMCplxO3	.equ	43BDh
_PushOP1	.equ	43C0h
_PushMCplxO1_lets_see_if_ti_screws_this_one_up	.equ	43C3h
_PushMCplx	.equ	43C6h
_ExMCplxO1	.equ	43C9h
_Exch9	.equ	43CCh
_CpyTo1FPS11	.equ	43CFh
_CpyTo2FPS5	.equ	43D2h
_CpyTo1FPS5	.equ	43D5h
_CpyTo2FPS6	.equ	43D8h
_CpyTo1FPS6	.equ	43DBh
_CpyTo2FPS7	.equ	43DEh
_CpyTo1FPS7	.equ	43E1h
_CpyTo1FPS8	.equ	43E4h
_CpyTo2FPS8	.equ	43E7h
_CpyTo1FPS10	.equ	43EAh
_CpyTo1FPS9	.equ	43EDh
_CpyTo2FPS4	.equ	43F0h
_CpyTo6FPS3	.equ	43F3h
_CpyTo6FPS2	.equ	43F6h
_CpyTo2FPS3	.equ	43F9h
_CpyCTo1FPS3	.equ	43FCh
_CpyTo1FPS3	.equ	43FFh
_CpyFPS3	.equ	4402h
_CpyTo1FPS4	.equ	4405h
_CpyTo3FPS2	.equ	4408h
_CpyTo5FPST	.equ	440Bh
_CpyTo6FPST	.equ	440Eh
_CpyTo4FPST	.equ	4411h
_CpyTo3FPST	.equ	4414h
_CpyTo2FPST	.equ	4417h
_CpyTo1FPST	.equ	441Ah
_CpyFPST	.equ	441Dh
_CpyStack	.equ	4420h
_CpyTo3FPS1	.equ	4423h
_CpyTo2FPS1	.equ	4426h
_CpyTo1FPS1	.equ	4429h
_CpyFPS1	.equ	442Ch
_CpyTo2FPS2	.equ	442Fh
_CpyTo1FPS2	.equ	4432h
_CpyFPS2	.equ	4435h
_CpyO3ToFPST	.equ	4438h
_CpyO2ToFPST	.equ	443Bh
_CpyO6ToFPST	.equ	443Eh
_CpyO1ToFPST	.equ	4441h
_CpyToFPST	.equ	4444h
_CpyToStack	.equ	4447h
_CpyO3ToFPS1	.equ	444Ah
_CpyO5ToFPS1	.equ	444Dh
_CpyO2ToFPS1	.equ	4450h
_CpyO1ToFPS1	.equ	4453h
_CpyToFPS1	.equ	4456h
_CpyO2ToFPS2	.equ	4459h
_CpyO3ToFPS2	.equ	445Ch
_CpyO6ToFPS2	.equ	445Fh
_CpyO1ToFPS2	.equ	4462h
_CpyToFPS2	.equ	4465h
_CpyO5ToFPS3	.equ	4468h
_CpyO2ToFPS3	.equ	446Bh
_CpyO1ToFPS3	.equ	446Eh
_CpyToFPS3	.equ	4471h
_CpyO1ToFPS6	.equ	4474h
_CpyO1ToFPS7	.equ	4477h
_CpyO1ToFPS5	.equ	447Ah
_CpyO2ToFPS4	.equ	447Dh
_CpyO1ToFPS4	.equ	4480h
_ErrNotEnoughMem	.equ	4483h
_FPSMinus9	.equ	4486h
_HLMinus9	.equ	4489h
_maybe_ErrOverflow	.equ	448Ch
_maybe_ErrDivBy0	.equ	448Fh
_ErrSingularMat	.equ	4492h
_ErrDomain	.equ	4495h
_ErrIncrement	.equ	4498h
_maybe_ErrNon_Real	.equ	449Bh
_ErrSyntax	.equ	449Eh
_ErrDataType	.equ	44A1h
_ErrArgument	.equ	44A4h
_ErrDimMismatch	.equ	44A7h
_ErrDimension	.equ	44AAh
_ErrUndefined	.equ	44ADh
_maybe_ErrMemory	.equ	44B0h
_maybe_ErrInvalid	.equ	44B3h
_ErrBreak	.equ	44B6h
_maybe_ErrStat	.equ	44B9h
_ErrSignChange	.equ	44BCh
_maybe_ErrIterations	.equ	44BFh
_maybe_ErrBadGuess	.equ	44C2h
_maybe_ErrTolTooSmall	.equ	44C5h
_maybe_ErrStatPlot	.equ	44C8h
_maybe_ErrLinkXmit	.equ	44CBh
_JError	.equ	44CEh
_noErrorEntry	.equ	44D1h
_pushErrorHandler	.equ	44D4h
_popErrorHandler	.equ	44D7h
_StrCopy	.equ	44DAh
_StrCat	.equ	44DDh
_IsInSet	.equ	44E0h
_GEQNAMEA	.equ	44E3h
_RECNAME	.equ	44E6h
___bank_call	.equ	44E9h
___bank_ret	.equ	44ECh
___bank_jump	.equ	44EFh
___bank_entry	.equ	44F2h
_PutMap	.equ	44F8h
_PutC	.equ	44FBh
_DispHL	.equ	44FEh
_PutS	.equ	4501h
_PutPSB	.equ	4504h
_PutPS	.equ	4507h
_WPutPS	.equ	450Ah
_PutBuf	.equ	450Dh
_PutBuf1	.equ	4510h
_WPutC	.equ	4513h
_WPutS	.equ	4516h
_WPutSEOL	.equ	4519h
_WDispEOL	.equ	451Ch
_WHomeUp	.equ	451Fh
_SetNumWindow	.equ	4522h
_NewLine	.equ	4525h
_MoveDown	.equ	4528h
_ScrollUp	.equ	452Bh
_ShrinkWindow	.equ	452Eh
_MoveUp	.equ	4531h
_ScrollDown	.equ	4534h
_maybe_ClrLCDFull	.equ	4537h
_maybe_ClrLCD	.equ	453Ah
_maybe_ClrScrnFull	.equ	453Dh
_maybe_ClrScrn	.equ	4540h
_maybe_ClrTxtShd	.equ	4543h
_ClrWindow	.equ	4546h
_maybe_EraseEOL	.equ	4549h
_EraseEOW	.equ	454Ch
_HomeUp	.equ	454Fh
_GetCurLoc	.equ	4552h
_VPutMap	.equ	4555h
_VPutS	.equ	4558h
_VPutSN	.equ	455Bh
_VPutSNG	.equ	455Eh
_VPutSNT	.equ	4561h
_maybe_RunIndicOn	.equ	4564h
_maybe_RunIndicOff	.equ	4567h
_SaveCmdShadow	.equ	456Ah
_SaveShadow	.equ	456Dh
_maybe_RstrShadow	.equ	4570h
_RstrPartial	.equ	4573h
_RstrCurRow	.equ	4576h
_RstrUnderMenu	.equ	4579h
_maybe_RstrBotRow	.equ	457Ch
_GetKeyPress	.equ	457Fh
_GetTokLen	.equ	4582h
_Get_Tok_Strng	.equ	4585h
_GetTokString	.equ	4588h
_maybe_PUTBPATBUF2	.equ	458Bh
_maybe_PUTBPATBUF	.equ	458Eh
_maybe_PUTBPAT	.equ	4591h
_maybe_putcCheckScroll	.equ	4594h
_maybe_DispEOL	.equ	4597h
_maybe_fdispEOL	.equ	459Ah
_MakeRowCmd	.equ	459Dh
_TOTOSTRP	.equ	45A0h
_DispDone	.equ	45A6h
_FinishOutput	.equ	45A9h
_CurBlink	.equ	45ACh
_CursorOff	.equ	45AFh
_HideCursor	.equ	45B2h
_CursorOn	.equ	45B5h
_ShowCursor	.equ	45B8h
_KeyToString	.equ	45BBh
_maybe_PullDownChk	.equ	45BEh
_maybe_MenuCatCommon	.equ	45C1h
_LoadCurCat	.equ	45C4h
_NCifprgmedmode	.equ	45C7h
_LoadMenuNum	.equ	45CAh
_LoadMenuNumL	.equ	45CDh
_maybe_MenuEdKey	.equ	45D0h
_MenCatRet	.equ	45D3h
_NotAlphNum	.equ	45D6h
_DispListName	.equ	45E5h
_DispLAlphaName	.equ	45E8h
_AbortPrgmode	.equ	45EBh
_Is_FullCntx	.equ	45EEh
_AdrMRow	.equ	45F1h
_AdrMEle	.equ	45F4h
_GetMatOP1A	.equ	45F7h
_GetM1ToOP1	.equ	45FAh
_GetM1TOP1A	.equ	45FDh
_GetMToOP1	.equ	4600h
_PutToM1A	.equ	4603h
_PutToMa1	.equ	4606h
_PutToMat	.equ	4609h
_Mat_El_Div	.equ	460Ch
_CMATFUN	.equ	460Fh
_RowEch_Poly	.equ	4612h
_RowEchelon	.equ	4615h
_AdrLEle	.equ	4618h
_GetL1ToOP1	.equ	461Bh
_GetL1TOP1A	.equ	461Eh
_GetLToOP1	.equ	4621h
_GetL1ToOP2	.equ	4624h
_GetL1TOP2A	.equ	4627h
_GetL2TOP1A	.equ	462Ah
_PutToLA1	.equ	462Dh
_PutToL	.equ	4630h
_MaxMinLst	.equ	4633h
_LLow	.equ	4636h
_LHigh	.equ	4639h
_LSum	.equ	463Ch
_CumSum	.equ	463Fh
_ToFrac	.equ	4642h
_SeqSet	.equ	4645h
_SeqSolve	.equ	4648h
_Cmp_Num_Init	.equ	464Bh
_BinOPExec	.equ	464Eh
_ExMean1	.equ	4651h
_Set2MVLPtrs	.equ	4654h
_SetMat1	.equ	4657h
_CreateTList	.equ	465Ah
_UnOPExec	.equ	465Dh
_ThreeExec	.equ	4660h
_RestoreErrNo	.equ	4663h
_FourExec	.equ	4666h
_FiveExec	.equ	4669h
_CpyTo2ES1	.equ	466Ch
_CpyTo6ES1	.equ	466Fh
_CpyTo1ES1	.equ	4672h
_CpyTo3ES1	.equ	4675h
_CpyTo3ES2	.equ	4678h
_CpyTo2ES2	.equ	467Bh
_CpyTo1ES2	.equ	467Eh
_CpyTo2ES3	.equ	4681h
_CpyTo1ES3	.equ	4684h
_CpyTo3ES4	.equ	4687h
_CpyTo6ES3	.equ	468Ah
_CpyTo2ES4	.equ	468Dh
_CpyTo1ES4	.equ	4690h
_CpyTo2ES5	.equ	4693h
_CpyTo1ES5	.equ	4696h
_CpyTo4EST	.equ	4699h
_CpyTo2EST	.equ	469Ch
_CpyTo1EST	.equ	469Fh
_CpyTo2ES6	.equ	46A2h
_CpyTo1ES6	.equ	46A5h
_CpyTo2ES7	.equ	46A8h
_CpyTo1ES7	.equ	46ABh
_CpyTo2ES8	.equ	46AEh
_CpyTo1ES8	.equ	46B1h
_CpyTo1ES9	.equ	46B4h
_CpyTo2ES9	.equ	46B7h
_CpyTo2ES10	.equ	46BAh
_CpyTo1ES10	.equ	46BDh
_CpyTo2ES11	.equ	46C0h
_CpyTo1ES11	.equ	46C3h
_CpyTo2ES12	.equ	46C6h
_CpyTo1ES12	.equ	46C9h
_CpyTo2ES13	.equ	46CCh
_CpyTo1ES13	.equ	46CFh
_CpyTo1ES14	.equ	46D2h
_CpyTo1ES16	.equ	46D5h
_CpyTo1ES17	.equ	46D8h
_CpyTo1ES18	.equ	46DBh
_CpyTo1ES15	.equ	46DEh
_CpyTo2ES15	.equ	46E1h
_CpyO1ToEST	.equ	46E4h
_CpyO1ToES1	.equ	46E7h
_CpyO6ToES1	.equ	46EAh
_CpyO6ToES3	.equ	46EDh
_CpyO1ToES2	.equ	46F0h
_CpyO2ToES2	.equ	46F3h
_CpyO1ToES3	.equ	46F6h
_CpyO1ToES4	.equ	46F9h
_CpyO1ToES5	.equ	46FCh
_CpyO1ToES6	.equ	46FFh
_CpyO1ToES7	.equ	4702h
_CpyO2ToES4	.equ	4705h
_CpyO2ToES5	.equ	4708h
_CpyO2ToES6	.equ	470Bh
_CpyO2ToES7	.equ	470Eh
_CpyO2ToES8	.equ	4711h
_CpyO2ToES9	.equ	4714h
_CpyO1ToES8	.equ	4717h
_CpyO1ToES9	.equ	471Ah
_CpyO1ToES10	.equ	471Dh
_CpyO1ToES11	.equ	4720h
_CpyO1ToES12	.equ	4723h
_CpyO1ToES13	.equ	4726h
_CpyO1ToES14	.equ	4729h
_EvalF3A	.equ	472Ch
_GetK	.equ	472Fh
_SetTitle	.equ	4732h
_DispVarVal	.equ	4735h
_maybe_RecallEd	.equ	4738h
_maybe_SetupBuffer	.equ	473Bh
_maybe_CreateNumEditBuf	.equ	473Eh
_maybe_CallCommon	.equ	4741h
_CommonKeys	.equ	4744h
_Leftmore	.equ	4747h
_fDel	.equ	474Ah
_maybe_fClear	.equ	474Dh
_maybe_fInsDisp	.equ	4750h
_maybe_fInsDisp02	.equ	4753h
_SetIndicator	.equ	4756h
_CloseEditBufNoR	.equ	4759h
_ReleaseBuffer	.equ	475Ch
_VarNameToOP1HL	.equ	475Fh
_NameToOP1	.equ	4762h
_maybe_numPPutAway	.equ	4765h
_maybe_numRedisp	.equ	4768h
_maybe_numError02	.equ	476Bh
_Load_SFont	.equ	476Eh
_SFont_Len	.equ	4771h
_maybe_InitNumVec	.equ	4774h
_SetXXOP1	.equ	4777h
_SetXXOP2	.equ	477Ah
_SetXXXXOP2	.equ	477Dh
_UCLineS	.equ	4780h
_CLine	.equ	4783h
_CLineS	.equ	4786h
_XRootY	.equ	4789h
_YToX	.equ	478Ch
_Mov18B	.equ	47C5h
_DarkLine	.equ	47C8h
_ILine	.equ	47CBh
_IPoint	.equ	47CEh
_XYRndBoth	.equ	47D1h
_XYRnd	.equ	47D4h
_CheckTop	.equ	47D7h
_CheckXY	.equ	47DAh
_DarkPnt	.equ	47DDh
_CPointS	.equ	47E0h
_WToV	.equ	47E3h
_VtoWHLDE	.equ	47E6h
_Xitof	.equ	47E9h
_YftoI	.equ	47ECh
_XftoI	.equ	47EFh
_maybe_GrLabels	.equ	4807h
_ChkTextCurs	.equ	4876h
_DoRefFlags02	.equ	487Ch
_YRes	.equ	487Fh
_PlotPtXY2	.equ	4882h
_maybe_PDspGrph	.equ	488Eh
_maybe_HorizCmd	.equ	4891h
_maybe_VertCmd	.equ	4894h
_maybe_LineCmd	.equ	4897h
_maybe_UnLineCmd	.equ	489Ah
_PutSM	.equ	48C4h
_VPutBlank	.equ	48DCh
_DispListNameY	.equ	48E2h
_CurNameLength	.equ	48E5h
_NameToBuf	.equ	48E8h
_JPromptCursor	.equ	48EBh
_BufLeft	.equ	48EEh
_BufRight	.equ	48F1h
_BufInsert	.equ	48F4h
_BufQueueChar	.equ	48F7h
_BufReplace	.equ	48FAh
_BufDelete	.equ	48FDh
_BufPeek	.equ	4900h
_BufPeek1	.equ	4903h
_BufPeek2	.equ	4906h
_BufPeek3	.equ	4909h
_BufToBtm	.equ	490Ch
_SetupEditEqu	.equ	490Fh
_BufToTop	.equ	4912h
_IsEditFull	.equ	4915h
_IsEditEmpty	.equ	4918h
_IsAtTop	.equ	491Bh
_IsAtBtm	.equ	491Eh
_JCursorFirst	.equ	4924h
_JCursorLast	.equ	4927h
_CursorLeft	.equ	492Ah
_JCursorRight	.equ	492Dh
_JCursorUp	.equ	4930h
_CursorDown	.equ	4933h
_CursorToOffset	.equ	4936h
_InsDisp	.equ	4939h
_FDispBOL1	.equ	493Ch
_FDispBOL	.equ	493Fh
_DispEOW	.equ	4942h
_DispHead	.equ	4945h
_DispTail	.equ	4948h
_PutTokString	.equ	494Bh
_SetupEditCmd	.equ	494Eh
_SetEmptyEditEqu	.equ	4951h
_SetEmptyEditPtr	.equ	4954h
_CloseEditEqu	.equ	4957h
_GetPrevTok	.equ	495Ah
_GetKey	.equ	495Dh
_FormDisp	.equ	4969h
_FormMatrix	.equ	496Ch
_WScrollLeft	.equ	496Fh
_WScrollUp	.equ	4972h
_WScrollDown	.equ	4975h
_WScrollRight	.equ	4978h
_FormEReal	.equ	497Bh
_FormERealTok	.equ	497Eh
_FormDCplx	.equ	4981h
_FormReal	.equ	4984h
_FormScrollUp	.equ	4987h
_SetWinAbove	.equ	498Ah
_DisarmScroll	.equ	498Dh
_OP1toEdit	.equ	4990h
_RclVarToEdit	.equ	4996h
_RclVarToEditPtr	.equ	4999h
_RclEntryToEdit	.equ	499Ch
_RclToQueue	.equ	499Fh
_Disp_Interval	.equ	49A5h
_maybe_EditEqu	.equ	49AEh
_maybe_CloseEquField	.equ	49B1h
_maybe_AutoSelect	.equ	49B4h
_DispYEOS	.equ	49B7h
_DispNumEOS	.equ	49BAh
_SetupDispEq	.equ	49BDh
_DispForward	.equ	49C0h
_DispYPrompt2	.equ	49C3h
_SaveScreen	.equ	49D2h
_RetScreen	.equ	49D5h
_RetScreenErr	.equ	49D8h
_CheckSplitFlag	.equ	49DBh
_maybe_SolveRedisp	.equ	49DEh
_maybe_SolveDisp	.equ	49E1h
_maybe_ItemName	.equ	49E4h
_ConvKeyToTok	.equ	49EDh
_KeyToTokNew2B	.equ	49F0h
_KeyToTok2Byte	.equ	49F3h
_TokToKey	.equ	49F6h
_Send1BErr	.equ	49F9h
_GetVarCmd	.equ	49FCh
_SendVarCmd	.equ	49FFh
_KeyScnLnk	.equ	4A05h
_ConvLcToLr	.equ	4A0Eh
_RedimMat	.equ	4A11h
_IncLstSize	.equ	4A14h
_InsertList	.equ	4A17h
_DelListEl	.equ	4A1Ah
_EditProg	.equ	4A1Dh
_CreateTemp	.equ	4A38h
_BC2NonReal	.equ	4A74h
_ErrNonReal	.equ	4A77h
_Write_Text	.equ	4A7Ah
_ForSeqInit	.equ	4A7Dh
_GrphPars	.equ	4A80h
_PlotPars	.equ	4A83h
_ParseInp	.equ	4A86h
_ParseOff	.equ	4A89h
_ParseScan	.equ	4A8Ch
_GetParse	.equ	4A8Fh
_SaveParse	.equ	4A92h
_InitPFlgs	.equ	4A95h
_CkEndLinErr	.equ	4A98h
_OP2Set60	.equ	4A9Bh
_GetStatPtr	.equ	4A9Eh
_Cmp_StatPtr	.equ	4AA1h
_VarSysAdr	.equ	4AA4h
_StoSysTok	.equ	4AA7h
_maybe_StoAns	.equ	4AAAh
_StoTheta	.equ	4AADh
_StoR	.equ	4AB0h
_StoY	.equ	4AB3h
_StoN	.equ	4AB6h
_StoT	.equ	4AB9h
_StoX	.equ	4ABCh
_StoOther	.equ	4ABFh
_RclAns	.equ	4AC2h
_RclY	.equ	4AC5h
_RclN	.equ	4AC8h
_RclX	.equ	4ACBh
_RclVarSym	.equ	4ACEh
_RclSysTok	.equ	4AD1h
_maybe_StMatEl	.equ	4AD4h
_maybe_StLstVecEl	.equ	4AD7h
_ConvOP1	.equ	4ADAh
_Find_Parse_Formula	.equ	4ADDh
_Parse_Formula	.equ	4AE0h
_StrngEnt1	.equ	4AE3h
_PrgRdLp	.equ	4AE6h
_VarEnt	.equ	4AE9h
_ParseOnC	.equ	4AECh
_ParseOn	.equ	4AEFh
_ParseCmd	.equ	4AF2h
_StoType	.equ	4AF5h
_CreatePair	.equ	4AF8h
_PushNum	.equ	4AFBh
_IncCurPCErrEnd	.equ	4AFEh
_ErrEnd	.equ	4B01h
_CommaErrF	.equ	4B04h
_CommaErr	.equ	4B07h
_StEqArg2	.equ	4B0Ah
_StEqArg	.equ	4B0Dh
_InpArg	.equ	4B10h
_StEqArg3	.equ	4B13h
_NxtFetch	.equ	4B16h
_maybe_CkFetchVar	.equ	4B19h
_maybe_FetchVarA	.equ	4B1Ch
_maybe_FetchVar	.equ	4B1Fh
_CkEndLin	.equ	4B22h
_CkEndExp	.equ	4B25h
_CkParsEnd	.equ	4B28h
_StoTypeArg	.equ	4B2Bh
_ConvDim	.equ	4B2Eh
_ConvDim00	.equ	4B31h
_maybe_ParsAheadS	.equ	4B37h
_AnsName	.equ	4B3Dh
_StoCmpReals	.equ	4B40h
_Push2BOper	.equ	4B46h
_Pop2BOper	.equ	4B49h
_PushOper	.equ	4B4Ch
_PopOper	.equ	4B4Fh
_Find_E_UndefOrArchived	.equ	4B52h
_StTmpEq	.equ	4B55h
_FindEOL	.equ	4B58h
_BrkInc	.equ	4B5Bh
_IncFetch	.equ	4B5Eh
_CurFetch	.equ	4B61h
_maybe_Factorial	.equ	4B70h
_YOnOff	.equ	4B73h
_EqSelUnsel	.equ	4B76h
_ITSOLVER	.equ	4B79h
_GRITSOLVER	.equ	4B7Ch
_ITSOLVERB	.equ	4B7Fh
_ITSOLVERNB	.equ	4B82h
_OutputExpr	.equ	4B9Dh
_Next_Y_Style	.equ	4BC7h
_maybe_SetPenX	.equ	4BD3h
_maybe_SetPenY	.equ	4BD6h
_maybe_SetPenT	.equ	4BD9h
_maybe_DispOP1A	.equ	4BE2h
_maybe_SetTblGraphDraw	.equ	4BEBh
_MemClear	.equ	4C1Bh
_MemSet	.equ	4C1Eh
_maybe_ReloadAppEntryVecs	.equ	4C21h
_PointOn	.equ	4C24h
_ExecuteNewPrgm	.equ	4C27h
_UserPutMap	.equ	4C2Dh
_GetCurrentPageSub	.equ	4C30h
_FindAppUp	.equ	4C33h
_FindAppDn	.equ	4C36h
_maybe_FindApp	.equ	4C39h
_maybe_ExecuteApp	.equ	4C3Ch
_IBounds	.equ	4C4Bh
_IOffset	.equ	4C4Eh
_maybe_DrawCirc2	.equ	4C51h
_maybe_CanAlphIns	.equ	4C54h
_maybe_Redisp	.equ	4C57h
_GetBaseVer	.equ	4C5Ah
_SetFP0	.equ	4C5Dh
_maybe_AppGetCbl	.equ	4C60h
_maybe_AppGetCalc	.equ	4C63h
_SetIgnoreKey	.equ	4C69h
_SetSendThisKeyBack	.equ	4C6Ch
_DisableApd	.equ	4C6Fh
_EnableAPD	.equ	4C72h
_forcecmd	.equ	4C7Bh
_ApdSetup	.equ	4C7Eh
_HandleLinkActivity	.equ	4C84h
_SGetTokString	.equ	4C96h
_LoadPattern	.equ	4C99h
_SStringLength	.equ	4C9Ch
_SPutTokString	.equ	4CF0h
_maybe_ErrCustom1	.equ	4D29h
_maybe_ErrCustom2	.equ	4D2Ch
_RstrCursorAndFlags	.equ	4D53h
_VerticalLine	.equ	4D7Dh
_IBoundsFull	.equ	4D80h
_CPoint	.equ	4DADh
_maybe_DeleteApp	.equ	4DB0h
_HorizontalLine	.equ	4E4Ch
_CreateAppVar	.equ	4E4Fh
_CreateProtProg	.equ	4E52h
_CreateVar	.equ	4E55h
_AsmComp	.equ	4E58h
_GetAsmSize	.equ	4E5Bh
_SquishPrgm	.equ	4E5Eh
_ExecutePrgm	.equ	4E61h
_ChkFindSymAsm	.equ	4E64h
_CSub	.equ	4E6Ah
_CAdd	.equ	4E6Dh
_CSquare	.equ	4E70h
_CMult	.equ	4E73h
_CRecip	.equ	4E76h
_CDiv	.equ	4E79h
_CAbs	.equ	4E7Ch
_CSqrAbs	.equ	4E7Fh
_CSqRoot	.equ	4E82h
_CLN	.equ	4E85h
_CLog	.equ	4E88h
_CTenX	.equ	4E8Bh
_CEtoX	.equ	4E8Eh
_CXrootY	.equ	4E91h
_CYtoX	.equ	4E97h
_Conj	.equ	4E9Ah
_CMltByReal	.equ	4E9Dh
_CDivByReal	.equ	4EA0h
_CTrunc	.equ	4EA3h
_CFrac	.equ	4EA6h
_CIntgr	.equ	4EA9h
_SendHeaderPacket	.equ	4EACh
_CancelTransmission	.equ	4EAFh
_SendRAMVarData	.equ	4EB5h
_SendRAMCmd	.equ	4EB8h
_SendPacket	.equ	4EBBh
_ReceiveAck	.equ	4EBEh
_GetSmallPacket	.equ	4ED0h
_GetDataPacket	.equ	4ED3h
_SendAck	.equ	4ED6h
_Get4Bytes	.equ	4ED9h
_Get3Bytes	.equ	4EDCh
_Rec1stByte	.equ	4EDFh
_Rec1stByteNC	.equ	4EE2h
_ContinueGetByte	.equ	4EE5h
_RecAByteIO	.equ	4EE8h
_ReceiveVar	.equ	4EEBh
_ReceiveVarData2	.equ	4EEEh
_maybe_ReceiveVarData	.equ	4EF1h
_Get4BytesCursor	.equ	4EFDh
_Get4BytesNC	.equ	4F00h
_SendReadyPacket	.equ	4F09h
_SendCmd	.equ	4F24h
_Disp	.equ	4F2Ah
_GetHookByte	.equ	4F36h
_LoadBIndPaged	.equ	4F39h
_CallCursorHook	.equ	4F3Ch
_CallRawKeyHook	.equ	4F42h
_SetCursorHook	.equ	4F45h
_SetRawKeyHook	.equ	4F4Bh
_ClrCursorHook	.equ	4F4Eh
_ClrRawKeyHook	.equ	4F54h
_AdjustAllHooks	.equ	4F5Ah
_CallGetKeyHook	.equ	4F5Dh
_SetGetKeyHook	.equ	4F60h
_ClrGetKeyHook	.equ	4F63h
_SetLocalizeHook	.equ	4F78h
_ClrLocalizeHook	.equ	4F7Bh
_Bit_VertSplit	.equ	4F8Dh
_SetWindowHook	.equ	4F96h
_ClrWindowHook	.equ	4F99h
_DelVarArc	.equ	4FABh
_DelVarNoArc	.equ	4FAEh
_SetAllPlots	.equ	4FB1h
_Arc_Unarc		.equ	4FBDh
_SetFontHook	.equ	4FC9h
_ClrFontHook	.equ	4FCCh
_SetRegraphHook	.equ	4FCFh
_ClrRegraphHook	.equ	4FD2h
_CallRegraphHook	.equ	4FD5h
_JForceGraphNoKey	.equ	4FE7h
_JForceGraphKey	.equ	4FEAh
_maybe_PowerOff	.equ	4FEDh
_GetKeyRetOff	.equ	4FF0h
_FindGroupSym	.equ	4FF3h
_maybe_FillBasePageTable	.equ	4FF6h
_maybe_ArcChk	.equ	4FF9h
_FlashToRam	.equ	4FFCh
_LoadDEIndPaged	.equ	4FFFh
_LoadCIndPaged	.equ	5002h
_SetupPagedPtr	.equ	5005h
_PagedGet	.equ	5008h
_SetDrawingHook	.equ	5017h
_ClrDrawingHook	.equ	501Ah
_IPoint_NoHook	.equ	501Dh
_ILine_NoHook	.equ	5020h
_CLineS_NoHook	.equ	5023h
_DispMenuTitle	.equ	504Ah
_GetBCOffsetIX	.equ	506Eh
_ForceFullScreen	.equ	5074h
_GetVariableData	.equ	5077h
_FindSwapSector	.equ	507Ah
_CopyFlashPage	.equ	507Dh
_FindAppNumPages	.equ	5080h
_HLMinus5	.equ	5083h
_SendArcPacket	.equ	5086h
_FormBase	.equ	508Fh
_Fake_Chk_Batt_Low	.equ	5098h
_Fake_Chk_Batt_Low2	.equ	509Bh
_maybe_GetAppBasePage	.equ	50A1h
_SetExSpeed	.equ	50A4h
_WriteToFlash	.equ	50B0h
_maybe_SendUSBData	.equ	50D4h
_GetVarCmdUSB	.equ	50DDh
_InvertTextInsMode	.equ	5104h
_DispHeader	.equ	5110h
_GetRelSeconds	.equ	5125h
_DisableClock	.equ	5128h
_EnableClock	.equ	512Bh
_GetDayOfWeek	.equ	512Eh
_GetDate	.equ	5131h
_FormDate	.equ	5134h
_GetDateFmt	.equ	5137h
_FormDateString	.equ	513Ah
_GetTime	.equ	513Dh
_FormTime	.equ	5140h
_GetTimeFmt	.equ	5143h
_FormTimeString	.equ	5146h
_GetClockStatus	.equ	5149h
_SetDateMakeList	.equ	514Ch
_SetDateFmt	.equ	514Fh
_SetTimeMakeList	.equ	5152h
_SetTimeFmt	.equ	5155h
_GetAbsSeconds	.equ	5158h
_AbsSecondsToTimeList	.equ	515Bh
_ClrWindowAndFlags	.equ	5161h
_ResetLists	.equ	5167h
_ExecLib	.equ	5173h
_OpenLib	.equ	517Fh
_WaitEnterKey	.equ	5182h
_Disp32	.equ	51AFh
_GetTokenCompatLevel	.equ	5221h
_SetUSBHook	.equ	5269h
_ClrUSBHook	.equ	526Ch
_maybe_InitUSBDevice	.equ	526Fh
_maybe_KillUSBPeripheral	.equ	5272h
_GraphLine	.equ	527Bh
_DelVarSym	.equ	52C3h
_FindAppUpNoCase	.equ	52C6h
_FindAppDnNoCase	.equ	52C9h
_maybe_DeleteApp_Link	.equ	52CFh
_maybe_CheckAppRestrictions	.equ	52DBh
_maybe_DispAppRestrictions	.equ	52DEh
_PolarEquToOP1	.equ	52F3h
_maybe_GetRestrictionsOptions	.equ	52FCh
_maybe_DispResetComplete	.equ	52FFh
_FindAppCustom	.equ	5305h
_GetFastCircCoord	.equ	53B0h
_WPutSN	.equ	5428h
_Load_LFont	.equ	5482h
_SendScreenContents	.equ	5575h
_SetTextFGColor_3	.equ	5581h
_SetTextFGColor_2	.equ	5584h
_SetTextFGColor	.equ	5587h
_VPutPS	.equ	558Ah
_MD5Final	.equ	8018h
_BigNumCompare	.equ	801Eh
_WriteAByteUnsafe	.equ	8021h
_EraseFlash	.equ	8024h
_FindFirstCertificateField	.equ	8027h
_ZeroToCertificate	.equ	802Ah
_GetCertificateEnd	.equ	802Dh
_FindGroupedField	.equ	8030h
_ATimesE	.equ	8042h
_ATimesDE	.equ	8045h
_DivHLByE	.equ	8048h
_DivHLByDE	.equ	804Bh
_LoadAIndPaged	.equ	8051h
_FlashToRAM2	.equ	8054h
_GetCertificateStart	.equ	8057h
_GetFieldSize	.equ	805Ah
_FindSubField	.equ	805Dh
_EraseCertificateSector	.equ	8060h
_ClearFullScreen	.equ	806Ch
_FindOSHeaderSubField	.equ	8075h
_FindNextCertificateField	.equ	8078h
_GetCalcSerial	.equ	807Eh
_EraseFlashPage	.equ	8084h
_WriteFlashUnsafe	.equ	8087h
_DispBootVer	.equ	808Ah
_FindAppHeaderSubField	.equ	80ABh
_Div32ByDE	.equ	80B1h
_FindSimpleGroupedField	.equ	80B4h
_WriteAByteSafe	.equ	80C6h
_WriteFlashSafe	.equ	80C9h

;======================================================================
;           Data Type Equates                                                    
;======================================================================
;
RealObj         EQU       0
ListObj         EQU       1
MatObj          EQU       2
EquObj          EQU       3
StrngObj        EQU       4
ProgObj         EQU       5
ProtProgObj     EQU       6
PictObj         EQU       7
GDBObj          EQU       8
UnknownObj      EQU       9
UnknownEquObj   EQU       0Ah
NewEquObj       EQU       0Bh
CplxObj         EQU       0Ch
CListObj        EQU       0Dh
UndefObj        EQU       0Eh
WindowObj       EQU       0Fh
ZStoObj         EQU       10h
TblRngObj       EQU       11h
LCDObj          EQU       12h
BackupObj       EQU       13h
AppObj		EQU	  14h		;application, only used in menus/link
AppVarObj	EQU	  15h		;application variable
TempProgObj     EQU       16h           ;program, home deletes when finished
GroupObj        EQU       17h           ;group.
